## yocto/meta-myco/conf/layer.conf
```bitbake
# We have a conf and classes directory, append to BBPATH
BBPATH .= ":${LAYERDIR}"

# We have recipes-* directories, add to BBFILES
BBFILES += "${LAYERDIR}/recipes-*/*/*.bb ${LAYERDIR}/recipes-*/*/*.bbappend"

BBFILE_COLLECTIONS += "meta-myco-dlt"
BBFILE_PATTERN_meta-myco-dlt = "^${LAYERDIR}/"
BBFILE_PRIORITY_meta-myco-dlt = "8"

LAYERSERIES_COMPAT_meta-myco-dlt = "kirkstone langdale mickledore nanbield scarthgap"
```
